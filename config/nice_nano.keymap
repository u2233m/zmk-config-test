#include <behaviors.dtsi>
#include <dt-bindings/zmk/keys.h>

/ {
    keymap {
        compatible = "zmk,keymap";

        default_layer {
            // Одна заглушка, соответствующая нашей виртуальной кнопке на P0.06
            bindings = <&none>;
        };
    };
};